## conf/machine/armefi64.conf
```bitbake
#@TYPE: Machine
#@NAME: armefi64
#@DESCRIPTION: Machine configuration for generic Arm SystemReady (EFI boot) compatible (RDK-B)
#@RDK_FLAVOR: rdkb
#@NEEDED_BSPLAYERS:

DEFAULTTUNE ?= "cortexa53"
require conf/machine/include/soc-family.inc
require conf/machine/include/arm/armv8a/tune-cortexa53.inc

EFI_PROVIDER ?= "${@bb.utils.contains("DISTRO_FEATURES", "systemd", "systemd-boot", "grub-efi", d)}"
SERIAL_CONSOLES ?= "115200;ttyAMA0 115200;hvc0 115200;ttyS0 115200;ttyS1 115200;ttyS2 115200;ttyPS1"
KERNEL_IMAGETYPE = "Image"

PREFERRED_PROVIDER_virtual/kernel ?= "linux-yocto"
PREFERRED_PROVIDER_virtual/bootloader ?= "u-boot"

MACHINE_FEATURES = "efi pci qemu-usermode rtc usbhost vfat wifi"
MACHINE_EXTRA_RRECOMMENDS += "kernel-modules"

#INITRAMFS_IMAGE = ""
UBOOT_MACHINE = "qemu_arm64_defconfig"

IMAGE_FSTYPES ?= "wic.zst"
WKS_FILE = "uefi-gpt.wks.in"

IMAGE_CLASSES += "qemuboot"
QB_SYSTEM_NAME ?= "qemu-system-aarch64"
QB_MACHINE ?= "-machine virt"
QB_SMP ?= "-smp 2"
QB_MEM ?= "-m 512"
QB_DEFAULT_BIOS ?= "u-boot.bin"
QB_CPU = "-cpu cortex-a53"
QB_MEM = "-m 1024"
QB_TAP_OPT ?= "-netdev tap,id=net0,ifname=@TAP@,script=no,downscript=no"
QB_FSINFO = "wic:no-kernel-in-fs"
QB_DEFAULT_KERNEL = "none"
QB_DEFAULT_FSTYPE = "wic.zst"

EXTRA_IMAGEDEPENDS += "virtual/bootloader"

# snapshot for wic.zst image type
TEST_RUNQEMUPARAMS ?= "snapshot"
# basic qemu testimage.bbclass support
TESTIMAGEDEPENDS:append = " qemu-native:do_populate_sysroot qemu-helper-native:do_populate_sysroot qemu-helper-native:do_addto_recipe_sysroot"
# If we're running testimage then we're in a qemu, so ensure u-boot is build
TESTIMAGEDEPENDS:append = " u-boot:do_deploy"
```
